/*********************************************************************************************
File:           BMV31M304A.cpp
Author:          BEST MODULES CORP.
Description:      single wire communicates with BM72D30x1_1 and controls audio playback
History：    V1.0.1   -- 2025-03-28
**********************************************************************************************/
#include "BMV31M304A.h"

#define PAUSE_PLAY      0XF1  //Pause playing the current voice and sentence command
#define CONTINUE_PLAY   0XF2  //Continue playing the paused voice and sentence command
#define LOOP_PLAY     0XF4  //Loop playback for the current voice and sentence command
#define STOP_PLAY       0XF8  //Stop playing the current voice and sentence command


/************************************************************************* 
Description:  Constructor
parameter:    theWire:I2C communication interface          
              busyPin:Player status,output high is playing       
Return:        None
Others:         None 
*************************************************************************/
BMV31M304A::BMV31M304A(uint8_t busyPin,TwoWire *theWire)
{
  _theWire = theWire; 
  _busyPin = busyPin;
  
}
/************************************************************************* 
Description:Initialize 
parameter:    void          
Return:    void    
Others:      None    
*************************************************************************/
void BMV31M304A::begin(void)
{
  _theWire->begin();
      pinMode(_busyPin, INPUT);
}
/************************************************************************* 
Description:    Set the volume
parameter:  volume：0~11(0:minimum volume（mute）;11:maximum volume)
Return:       void   
Others:       None   
*************************************************************************/
void BMV31M304A::setVolume(uint8_t volume)
{
    if(volume>11)volume=11;
  I2C_writeByte(0xe1 + volume);
  delay(30);
}
/************************************************************************* 
Description:    Play voice.
parameter:  num：VOC_01~VOC_256(Enter the number according to the number of the voice 
                generated by the PC tool.The maximum number is VOC_256. )
            loop：default 0.(1：Loops the current voice，0：Play it only once)         
Return:        void
Others:        None  
*************************************************************************/
void BMV31M304A::playVoice(uint8_t num, bool loop)
{
    if(num < 128)
    {
        I2C_writeByte(0xfa, num);
    }
    else
    {
        I2C_writeByte(0xfb, num % 128);
    }
  
  if(loop)
  {
    I2C_writeByte(0xf4);
  }
  delay(30);
}
/************************************************************************* 
Description:    Play sentence.
parameter:    num：SEN_01~SEN_96(Enter the number according to the number of the sentence 
                    generated by the PC tool.The maximum number is SEN_96. )
              loop：default 0.(1：Loops the current sentence，0：Play it only once)                  
Return:         void
Others:          None
*************************************************************************/
void BMV31M304A::playSentence(uint8_t num, bool loop)
{
    if(num>=96)num=96;

  I2C_writeByte(num+0x80);

  if(loop)
  {
    I2C_writeByte(0xf4);
  }
  delay(30);
}
/************************************************************************* 
Description:    Stop playing the current voice and sentence.
parameter:     void           
Return:        void  
Others:         None 
*************************************************************************/
void BMV31M304A::playStop(void)
{
  I2C_writeByte(STOP_PLAY);
  delay(30);
}
/************************************************************************* 
Description:    Pause playing the current voice and sentence.
parameter:     void           
Return:        void
Others:          None
*************************************************************************/
void BMV31M304A::playPause(void)
{
  I2C_writeByte(PAUSE_PLAY);
}
/************************************************************************* 
Description:    Continue playing the paused voice and sentence.
parameter:     void           
Return:        void
Others:          None
*************************************************************************/
void BMV31M304A::playContinue(void)
{
  I2C_writeByte(CONTINUE_PLAY);
  delay(30);
}
/************************************************************************* 
Description:    Loop playback the current voice/sentence
parameter:     void           
Return:        void
Others:          None
*************************************************************************/
void BMV31M304A::playRepeat(void)
{
    I2C_writeByte(LOOP_PLAY);
    delay(30);
}
/************************************************************************* 
Description:    Get the play status
parameter:     void           
Return: 0:Not in the play
        1:In the play
Others:         
*************************************************************************/
bool BMV31M304A::isPlaying(void)
{
  if (HIGH == digitalRead(_busyPin))
  {
    return true;
  }
  else
  {
    return false;
  }
  
}

/************************************************************************* 
Description:    write 2 data to I2C slave
parameter:    data1 : data 1 to write
              data2 : data 2 to write  
Return:          void
Others:          None
*************************************************************************/
void BMV31M304A::I2C_writeByte(uint8_t data1,uint8_t data2)
{
    _theWire->beginTransmission(I2C_SLAVE_ADDRESS); 
    _theWire->write(data1);             
     _theWire->write(data2);            
    _theWire->endTransmission();      

}
/************************************************************************* 
Description:    write 1 data to I2C slave
parameter:    data1 : data 1 to write                
Return:          void
Others:          None
*************************************************************************/
void BMV31M304A::I2C_writeByte(uint8_t data)
{
    _theWire->beginTransmission(I2C_SLAVE_ADDRESS); 
    _theWire->write(data);              
    _theWire->endTransmission();       

}
